## boards/shields/imprint_dongle/Kconfig.shield
```kconfig
config SHIELD_IMPRINT_DONGLE
    def_bool $(shield_list_contains,imprint_dongle)
```

## config/west.yml
```yaml
manifest:
  remotes:
    - name: zmkfirmware
      url-base: https://github.com/zmkfirmware

    - name: Cyboard-DigitalTailor
      url-base: https://github.com/Cyboard-DigitalTailor

    - name: englmaxi
      url-base: https://github.com/englmaxi

  projects:
    - name: zmk
      remote: zmkfirmware
      revision: ff09f2d0c9f13a868c8f71d71d9348ade438e4b6
      import: app/west.yml

    - name: zmk-keyboards
      remote: Cyboard-DigitalTailor
      revision: 10523ad
      import: config/west.yml

    - name: zmk-dongle-display
      remote: englmaxi
      revision: main

  self:
    path: config
```
